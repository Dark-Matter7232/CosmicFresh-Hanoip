## drivers/input/fingerprint/Kconfig
```kconfig
#
# Fingerprint driver configuration
#
menuconfig INPUT_FINGERPRINT
	bool "Fingerprints"
	default y
	help
	  Say Y here, and a list of supported fingerprints will be displayed.
	  This option doesn't affect the kernel.

	  If unsure, say Y.

if INPUT_FINGERPRINT

source "drivers/input/fingerprint/goodix_fod_mmi/Kconfig"

endif
```

## drivers/input/fingerprint/chipone_fps_mmi/Kconfig
```kconfig
config FINGERPRINT_CHIPONE_FPS_MMI
	tristate "Finger print card Chipone MMI"
	depends on INPUT_FINGERPRINT
	default n
	help
	  Say Y here to enable support for Fingerprint chip TEE driver

	  If unsure, say N.

	  To compile this driver as a module, choose M here.
```

## drivers/input/fingerprint/goodix_fod_mmi/Kconfig
```kconfig
config FINGERPRINT_GOODIX_FOD_MMI
	tristate "Finger print card goodix MMI"
	depends on INPUT_FINGERPRINT
	default n
	help
	  Say Y here to enable support for retrieving self-test reports.

	  If unsure, say N.

	  To compile this driver as a module, choose M here.
```

## drivers/input/touchscreen/ilitek_v3_mmi/Kconfig
```kconfig
#
# Ilitek touchscreen driver configuration
#
config TOUCHSCREEN_ILITEK_CHIPSET
	tristate "TOUCHSCREEN_ILITEK CHIPSET"
	help
	  Say Y here if you have a Elan CHIPSET touchscreen.
	  ELAN controllers are multi touch controllers which can
	  report 10 touches at a time.

	  If unusre, say N.

config INPUT_ILI_0FLASH_MMI_ENABLE_DOUBLE_TAP
	bool "Moto Ilitek Doubel tap"
	depends on TOUCHSCREEN_ILITEK_CHIPSET
	default n
	help
	  Say Y here if you want to have Double tap support on Moto Ilitek.

	  If unsure, say N.

config INPUT_ILI_PANEL_NOTIFICATIONS
	bool "Moto Ilitek panel notification"
	depends on TOUCHSCREEN_ILITEK_CHIPSET
	default n
	help
	  Say Y here if you want to have panel notification support on Moto Ilitek.

	  If unsure, say N.

config ILITEK_RESUME_BY_DDI
	bool "Moto Ilitek firmware by display"
	depends on TOUCHSCREEN_ILITEK_CHIPSET
	default n
	help
	  Say Y here if you want to firmware by display support on Moto Ilitek.

	  If unsure, say N.

config ILITEK_FW_PANEL
	bool "Moto Ilitek firmware by panel"
	depends on TOUCHSCREEN_ILITEK_CHIPSET
	default n
	help
	  Say Y here if you want to firmware by panel support on Moto Ilitek.

	  If unsure, say N.

config ILITEK_ESD
	bool "Moto Ilitek ESD by panel"
	depends on TOUCHSCREEN_ILITEK_CHIPSET
	default n
	help
	  Say Y here if you want to support ESD on Moto Ilitek.

	  If unsure, say N.

config ILITEK_GESTURE
	bool "Moto Ilitek gesture by panel"
	depends on TOUCHSCREEN_ILITEK_CHIPSET
	default n
	help
	  Say Y here if you want to support gesture on Moto Ilitek.

	  If unsure, say N.
```

## drivers/misc/abov_a96t/Kconfig
```kconfig
config INPUT_ABOV_A96T
        tristate "ABOV_A96T_SAR_sensor"
        depends on I2C
        default n
        help
          Say Y to enable the SAR detection application, if N here not to use the
          this SAR sensor
```

## drivers/popup/Kconfig
```kconfig
source "drivers/popup/akm09970/Kconfig"
source "drivers/popup/aw8646/Kconfig"
source "drivers/popup/mxm1120/Kconfig"
```

## drivers/popup/akm09970/Kconfig
```kconfig
config POPUP_AKM09970
	tristate "AKM09970 POPUP"
	default n
	help
	  Say Y here if you have a AKM09970 compatible
	  device connected.

	  This driver can also be built as a module.  If so, the module
	  will be called akm09970.
```

## drivers/popup/aw8646/Kconfig
```kconfig
config POPUP_AW8646
	tristate "AW8646 POPUP"
	default n
	help
	  Say Y here if you have a AW8646 compatible
	  device connected.

	  This driver can also be built as a module.  If so, the module
	  will be called aw8646.

config USE_HW_CLK
	bool "Use hardware clock for AW8646 POPUP"
	depends on POPUP_AW8646
	default n
	help
	  Say Y here if you want to use hw clock.
```

## drivers/popup/mxm1120/Kconfig
```kconfig
config POPUP_MXM1120
	tristate "mxm1120 POPUP"
	default n
	help
	  Say Y here if you have a MXM1120 compatible
	  device connected.

	  This driver can also be built as a module.  If so, the module
	  will be called mxm1120.
```

## drivers/power/bq2597x_mmi/Kconfig
```kconfig
config BQ2597X_MMI
        tristate "BQ2597X"
        default n
        help
         Say Y here if you have a BQ2597X compatible
         device connected.

config BQ2597X_DUAL
        bool "BQ2597X DUAL"
        depends on BQ2597X_MMI
        default n
        help
         Say Y here if your chip uses the BQ2597X DUAL

         This driver can also be built as a module.  If so, the module
         will be called bq2597x_dual_mmi.

config BQ2597X_SINGLE
        bool "BQ2597X SINGLE"
        depends on BQ2597X_MMI
        default n
        help
         Say Y here if your chip uses the BQ2597X SINGLE

         This driver can also be built as a module.  If so, the module
         will be called bq2597x_single_mmi.
```

## drivers/power/bq27426_fg_mmi/Kconfig
```kconfig
config BQ27426_FG_MMI
        tristate "BQ27426 FG"
        default n
        help
         Say Y here if you have a bq27426 fg compatible
         device connected.

         This driver can also be built as a module.  If so, the module
         will be called bq27426_fg_mmi.

config ATL_4000MAH_8A_BATTERY_PROFILE
        bool "ATL 4000MAH 8A BATTERY PROFILE"
        depends on BQ27426_FG_MMI
        default n
        help
         Say Y here if your chip uses the ATL 4000MAH 8A BATTERY PROFILE

config SCUD_4000MAH_8A_BATTERY_PROFILE
        bool "SCUD 4000MAH 8A BATTERY PROFILE"
        depends on BQ27426_FG_MMI
        default n
        help
         Say Y here if your chip uses the SCUD 4000MAH 8A BATTERY PROFILE
```

## drivers/power/mmi_parallel_charger/Kconfig
```kconfig
config MMI_PARALLEL_CHARGER
        tristate "MOTO PARALLEL CHARGER"
        default n
        help
         Say Y here if you have a moto parallel charger.

         This driver can also be built as a module.  If so, the module
         will be called mmi_parallel_charger.
```
